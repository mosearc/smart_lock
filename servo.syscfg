/**
 * @cliArgs --board "/ti/boards/MSP_EXP432P401R" --product "simplelink_msp432p4_sdk@3.40.01.02"
 * @versions {"tool":"1.18.0+3266"}
 */

/**
 * Import the modules used in this configuration.
 */
const GPIO   = scripting.addModule("/ti/drivers/GPIO", {}, false);
const GPIO1  = GPIO.addInstance();
const PWM    = scripting.addModule("/ti/drivers/PWM", {}, false);
const PWM1   = PWM.addInstance();
const PWM2   = PWM.addInstance();
const Power  = scripting.addModule("/ti/drivers/Power");
const SPI    = scripting.addModule("/ti/drivers/SPI", {}, false);
const SPI1   = SPI.addInstance();
const Timer  = scripting.addModule("/ti/drivers/Timer", {}, false);
const Timer1 = Timer.addInstance();
const Timer2 = Timer.addInstance();
const UART   = scripting.addModule("/ti/drivers/UART", {}, false);
const UART1  = UART.addInstance();

/**
 * Write custom configuration values to the imported modules.
 */
GPIO1.$name           = "CONFIG_GPIO_CS_PIN";
GPIO1.mode            = "Output";
GPIO1.gpioPin.$assign = "boosterpack.12";

PWM1.$name                = "CONFIG_PWM_0";
PWM1.timer.pwmPin.$assign = "boosterpack.37";

PWM2.$name                = "CONFIG_PWM_1";
PWM2.timer.pwmPin.$assign = "boosterpack.40";

Power.performanceLevel3.$name = "ti_drivers_power_PowerMSP432PerfLevels0";
Power.performanceLevel2.$name = "ti_drivers_power_PowerMSP432PerfLevels1";
Power.performanceLevel1.$name = "ti_drivers_power_PowerMSP432PerfLevels2";
Power.performanceLevel0.$name = "ti_drivers_power_PowerMSP432PerfLevels3";

SPI1.$name = "CONFIG_SPI_0";

Timer1.$name             = "CONFIG_TIMER_0";
Timer1.interruptPriority = "1";
Timer1.timer.$assign     = "Timer_A1";

Timer2.$name             = "CONFIG_TIMER_1";
Timer2.interruptPriority = "2";
Timer2.timer.$assign     = "Timer_A3";

UART1.$name              = "CONFIG_UART_0";
UART1.uart.txPin.$assign = "boosterpack.4";
UART1.uart.rxPin.$assign = "boosterpack.3";

/**
 * Pinmux solution for unlocked pins/peripherals. This ensures that minor changes to the automatic solver in a future
 * version of the tool will not impact the pinmux you originally saw.  These lines can be completely deleted in order to
 * re-solve from scratch.
 */
PWM1.timer.$suggestSolution                  = "Timer_A2";
PWM2.timer.$suggestSolution                  = "Timer_A0";
SPI1.spi.$suggestSolution                    = "EUSCI_B0";
SPI1.spi.sclkPin.$suggestSolution            = "boosterpack.7";
SPI1.spi.misoPin.$suggestSolution            = "boosterpack.14";
SPI1.spi.mosiPin.$suggestSolution            = "boosterpack.15";
SPI1.spi.dmaRxChannel.$suggestSolution       = "DMA_CH1";
SPI1.spi.dmaTxChannel.$suggestSolution       = "DMA_CH0";
SPI1.spi.dmaInterruptNumber.$suggestSolution = "DMA_INT0";
UART1.uart.$suggestSolution                  = "EUSCI_A1";
